## main/Kconfig.projbuild
```kconfig
menu "*** Project Configuration ***"

    config APP_WIFI_SSID
        string "WiFi SSID"
        default "myssid"
        help
            Default SSID (network name) to connect to.

    config APP_WIFI_PASSWORD
        string "WiFi Password"
        default "mypassword"
        help
            Default WiFi password (WPA or WPA2) to use.

    config APP_WIFI_MAXIMUM_RETRY
        int "Maximum Wifi retry"
        default 5
        help
            The number of consecutive connection retry to the WiFi AP

    choice ESP_WIFI_SCAN_AUTH_MODE_THRESHOLD
        prompt "WiFi Scan auth mode threshold"
        default ESP_WIFI_AUTH_WPA2_PSK
        help
            The weakest authmode to accept in the scan mode.
            This value defaults to ESP_WIFI_AUTH_WPA2_PSK incase password is present and ESP_WIFI_AUTH_OPEN is used.
            Please select ESP_WIFI_AUTH_WEP/ESP_WIFI_AUTH_WPA_PSK incase AP is operating in WEP/WPA mode.

        config ESP_WIFI_AUTH_OPEN
            bool "OPEN"
        config ESP_WIFI_AUTH_WEP
            bool "WEP"
        config ESP_WIFI_AUTH_WPA_PSK
            bool "WPA PSK"
        config ESP_WIFI_AUTH_WPA2_PSK
            bool "WPA2 PSK"
        config ESP_WIFI_AUTH_WPA_WPA2_PSK
            bool "WPA/WPA2 PSK"
        config ESP_WIFI_AUTH_WPA3_PSK
            bool "WPA3 PSK"
        config ESP_WIFI_AUTH_WPA2_WPA3_PSK
            bool "WPA2/WPA3 PSK"
        config ESP_WIFI_AUTH_WAPI_PSK
            bool "WAPI PSK"
    endchoice

    config TELNET_PORT
        int "Telnet port"
        range 0 65535
        default 22
        help
           The port used by the telnet server.          

    config ACR_FRAME_SIZE
        int "AC relay frame size"
        range 10 200
        default 25
        help
          This is the number of half-periods over which the power should be adjusted.
          For example, a frame of 100 has a duration of 1 second with 50hz AC. 

    config FULL_POWER
        int "Full power of the relay"
        range 1 3000
        default 650
        help
          The power (in W) when the AC relay is running at 100%. 

    config RELAY_GPIO
        int "AC Relay GPIO number"
        range 0 100
        default 32 if IDF_TARGET_ESP32
        default 5 if IDF_TARGET_ESP32C6
        default 5 
        help
          GPIO number (IOxx) to control the AC Relay.

    config RGB_GPIO
        int "RGB Led GPIO number"
        range -1 100
        default -1 if IDF_TARGET_ESP32
        default 8 if IDF_TARGET_ESP32C6
        default 8 if IDF_TARGET_ESP32H2
        default -1
        help
          GPIO number (IOxx) to control the on-board RGB led or -1

    config LED_GPIO
        int "Led GPIO number"
        range -1 100
        default 2 if IDF_TARGET_ESP32
        default -1 if IDF_TARGET_ESP32C6
        default -1 if IDF_TARGET_ESP32H2
        default -1
        help
          GPIO number (IOxx) to control the on-board led or -1

    config BUTTON_A_GPIO
        int "Button A GPIO number"
        range 0 100
        default 4 if IDF_TARGET_ESP32
        default 3
        help
          GPIO number (IOxx) for the primary button.
          Activate by connecting to GND. 

    config BUTTON_B_GPIO
        int "Button B GPIO number"
        range 0 100
        default 0 if IDF_TARGET_ESP32
        default 9 if IDF_TARGET_ESP32C6
        default 9 if IDF_TARGET_ESP32H2
        default 20
        help
          GPIO number (IOxx) for the secondary button.
          Activate by connecting to GND.
          This is typically the BOOT button found on most development boards.

    config MQTT_BROKER_URI
        string "MQTT URI"
        default "mqtt://username:password@mqtt.private:1883"
        help
           URI of the MQTT broker

endmenu
```

## sdkconfig.defaults
```kconfig
#
# See also main/Kconfig.projbuild for the application defaults.
#

CONFIG_PARTITION_TABLE_CUSTOM=y
CONFIG_PARTITION_TABLE_CUSTOM_FILENAME="partitions.csv"
CONFIG_PARTITION_TABLE_FILENAME="partitions.csv"
CONFIG_PARTITION_TABLE_OFFSET=0x8000
CONFIG_PARTITION_TABLE_MD5=y

# Try to reduce code size by removing a few features from
# system libraries (the linker already does a good job
# by ignoring object files that are not referenced so
# removing support here is only useful for libraries that
# we are partially using. 
CONFIG_ESP_WIFI_SOFTAP_SUPPORT=n
```
